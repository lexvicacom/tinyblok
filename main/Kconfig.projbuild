## main/Kconfig.projbuild
```kconfig
menu "tinyblok"

    config TINYBLOK_WIFI_SSID
        string "Default Wi-Fi SSID"
        default "myssid"
        help
            Build-time default copied into runtime config before the user
            saves settings in the setup portal.

    config TINYBLOK_WIFI_PASSWORD
        string "Default Wi-Fi password"
        default ""
        help
            Build-time default copied into runtime config before the user
            saves settings in the setup portal. Leave empty for an open AP.

    config TINYBLOK_SETUP_AP_PASSWORD
        string "Setup portal SoftAP password"
        default ""
        help
            Optional setup AP passphrase. Leave empty for an open setup AP.
            WPA2 is used when this is at least 8 characters.

    config TINYBLOK_DEVICE_NAME
        string "Default device name"
        default "tinyblok"
        help
            Build-time default used before runtime settings are saved.

    config TINYBLOK_NATS_HOST
        string "Default NATS broker host"
        default "demo.rtd.pub"
        help
            Hostname or dotted-quad IP of the NATS broker the device
            publishes to. No DNS resolution beyond what lwIP does.

    config TINYBLOK_NATS_PORT
        int "Default NATS broker port"
        default 4222
        range 1 65535
        help
            TCP port of the NATS broker. Standard is 4222.

    config TINYBLOK_NATS_BASE_TOPIC
        string "Default NATS base topic"
        default "tinyblok"
        help
            Runtime-configurable topic prefix reserved for user-facing flows.
            The current patchbay rules still publish their generated subjects.

    config TINYBLOK_NATS_TLS
        bool "Enable runtime NATS TLS support"
        default y
        help
            Compile in TLS support for the NATS client. The setup portal
            still decides at runtime whether an individual broker uses TLS.

            Uses NATS' INFO-first TLS flow: the broker sends plaintext
            INFO, then the client upgrades to TLS before CONNECT.

    config TINYBLOK_NATS_TLS_BUNDLE
        bool "Verify server with built-in CA bundle"
        depends on TINYBLOK_NATS_TLS
        default y
        help
            Use ESP-IDF's bundled Mozilla CA roots to verify the
            broker's certificate. Disable for self-signed brokers
            (insecure: skips verification).

    config TINYBLOK_NATS_CREDS_SUPPORT
        bool "Enable runtime NATS .creds auth support"
        depends on TINYBLOK_NATS_TLS
        default y
        help
            Compile in the .creds parser and Ed25519 signer. The .creds
            text is uploaded through the setup portal and stored in NVS;
            no per-user secret is embedded in firmware.

    config TINYBLOK_DISPLAY_ENABLED_DEFAULT
        bool "Display enabled by default"
        default y

    config TINYBLOK_DISPLAY_BRIGHTNESS_DEFAULT
        int "Display brightness default"
        default 255
        range 0 255

    config TINYBLOK_DISPLAY_I2C_SDA_GPIO
        int "Display I2C SDA GPIO"
        default 14
        range 0 30

    config TINYBLOK_DISPLAY_I2C_SCL_GPIO
        int "Display I2C SCL GPIO"
        default 15
        range 0 30

    config TINYBLOK_SAMPLE_INTERVAL_MS
        int "Default sample interval (ms)"
        default 1000
        range 100 86400000

    config TINYBLOK_TIMEZONE
        string "Default timezone"
        default "UTC"

    choice TINYBLOK_DISPLAY_OLED_SIZE
        prompt "SSD1306 OLED size"
        default TINYBLOK_DISPLAY_OLED_128X64

        config TINYBLOK_DISPLAY_OLED_128X64
            bool "128x64"
            help
                Common 0.96 inch SSD1306 module. Uses 8 display pages.

        config TINYBLOK_DISPLAY_OLED_128X32
            bool "128x32"
            help
                Smaller SSD1306 module. Uses 4 display pages and adjusted
                COM pin setup.

        config TINYBLOK_DISPLAY_OLED_128X48
            bool "128x48"
            help
                Taller SSD1306-compatible module. Uses 6 display pages and
                leaves room for a third status line.
    endchoice

    config TINYBLOK_DISPLAY_OLED_128X32_THREE_ROWS
        bool "Use compact 3-row layout on 128x32 OLED"
        depends on TINYBLOK_DISPLAY_OLED_128X32
        default n
        help
            Draw a third text line on a 128x32 OLED while keeping the
            controller initialized for 32 pixel rows. This uses consecutive
            8-pixel pages and may look cramped on some modules.

endmenu
```

## sdkconfig.defaults
```kconfig
# Pinned across checkouts. Per-device values (Wi-Fi creds, anything secret)
# stay out of here — set via `idf.py menuconfig`, which writes to the
# gitignored `sdkconfig` file.
CONFIG_IDF_TARGET="esp32c6"

CONFIG_ESPTOOLPY_FLASHMODE_DIO=y
CONFIG_ESPTOOLPY_FLASHFREQ_80M=y
CONFIG_ESPTOOLPY_FLASHSIZE_4MB=y

CONFIG_PARTITION_TABLE_CUSTOM=y
CONFIG_PARTITION_TABLE_CUSTOM_FILENAME="partitions.csv"

CONFIG_TINYBLOK_NATS_TLS=y
CONFIG_TINYBLOK_NATS_TLS_BUNDLE=y
CONFIG_TINYBLOK_NATS_CREDS_SUPPORT=y

# TweetNaCl signing (creds auth) plus the TLS handshake share the main task
# stack. Default 3584 bytes overflows during crypto_sign — bump to 8 KB.
CONFIG_ESP_MAIN_TASK_STACK_SIZE=8192

# Pump and clock patchbay evaluation runs on Tinyblok's own task, not the
# ESP default event-loop task. Match the main task stack budget.
CONFIG_TINYBLOK_DRIVER_TASK_STACK_SIZE=8192
CONFIG_TINYBLOK_DRIVER_EVENT_QUEUE_LEN=32
```
