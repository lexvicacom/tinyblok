## examples/component-firmware/sdkconfig.defaults
```kconfig
CONFIG_IDF_TARGET="esp32c6"

CONFIG_ESPTOOLPY_FLASHMODE_DIO=y
CONFIG_ESPTOOLPY_FLASHFREQ_80M=y
CONFIG_ESPTOOLPY_FLASHSIZE_4MB=y

CONFIG_PARTITION_TABLE_CUSTOM=y
CONFIG_PARTITION_TABLE_CUSTOM_FILENAME="partitions.csv"

CONFIG_TINYBLOK_NATS_TLS=y
CONFIG_TINYBLOK_NATS_TLS_BUNDLE=y
CONFIG_TINYBLOK_NATS_CREDS_SUPPORT=y

CONFIG_ESP_MAIN_TASK_STACK_SIZE=8192
CONFIG_TINYBLOK_DRIVER_TASK_STACK_SIZE=8192
CONFIG_TINYBLOK_DRIVER_EVENT_QUEUE_LEN=32
```
